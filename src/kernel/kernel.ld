ENTRY(main);
OUTPUT_FORMAT("binary");

BASE = 0x00106000;

SECTIONS
{
	. = BASE;
	.text :
	{
		main.o(.text)
		chain_string.o(.text)
		cmos.o(.text)
		console.o(.text)
		disk.o(.text)
		elf.o(.text)
		exception.o(.text)
		font.o(.text)
		fontdata.o(.text)
		gdt.o(.text)
		graphic.o(.text)
		idt.o(.text)
		interrupt_gates.o(.text)
		interrupt_handlers.o(.text)
		io.o(.text)
		keyboard.o(.text)
		libgcc.o(.text)
		math.o(.text)
		memory.o(.text)
		mouse.o(.text)
		mouse_cursor.o(.text)
		parallel.o(.text)
		peripheral.o(.text)
		pic.o(.text)
		pit.o(.text)
		queue.o(.text)
		rtc.o(.text)
		serial.o(.text)
		sheet.o(.text)
		shell.o(.text)
		stack.o(.text)
		stdio.o(.text)
		string.o(.text)
		task.o(.text)
		text_box.o(.text)
		timer.o(.text)
		window.o(.text)
	}
	.rodata :
	{
		main.o(.rodata)
		chain_string.o(.rodata)
		cmos.o(.rodata)
		console.o(.rodata)
		disk.o(.rodata)
		elf.o(.rodata)
		exception.o(.rodata)
		font.o(.rodata)
		fontdata.o(.rodata)
		gdt.o(.rodata)
		graphic.o(.rodata)
		idt.o(.rodata)
		interrupt_gates.o(.rodata)
		interrupt_handlers.o(.rodata)
		io.o(.rodata)
		keyboard.o(.rodata)
		libgcc.o(.rodata)
		math.o(.rodata)
		memory.o(.rodata)
		mouse.o(.rodata)
		mouse_cursor.o(.rodata)
		parallel.o(.rodata)
		peripheral.o(.rodata)
		pic.o(.rodata)
		pit.o(.rodata)
		queue.o(.rodata)
		rtc.o(.rodata)
		serial.o(.rodata)
		sheet.o(.rodata)
		shell.o(.rodata)
		stack.o(.rodata)
		stdio.o(.rodata)
		string.o(.rodata)
		task.o(.rodata)
		text_box.o(.rodata)
		timer.o(.rodata)
		window.o(.rodata)
	}
	.data :
	{
		main.o(.data)
		chain_string.o(.data)
		cmos.o(.data)
		console.o(.data)
		disk.o(.data)
		elf.o(.data)
		exception.o(.data)
		font.o(.data)
		fontdata.o(.data)
		gdt.o(.data)
		graphic.o(.data)
		idt.o(.data)
		interrupt_gates.o(.data)
		interrupt_handlers.o(.data)
		io.o(.data)
		keyboard.o(.data)
		libgcc.o(.data)
		math.o(.data)
		memory.o(.data)
		mouse.o(.data)
		mouse_cursor.o(.data)
		parallel.o(.data)
		peripheral.o(.data)
		pic.o(.data)
		pit.o(.data)
		queue.o(.data)
		rtc.o(.data)
		serial.o(.data)
		sheet.o(.data)
		shell.o(.data)
		stack.o(.data)
		stdio.o(.data)
		string.o(.data)
		task.o(.data)
		text_box.o(.date)
		timer.o(.data)
		window.o(.data)
	}
	.bss :
	{
		main.o(.bss)
		chain_string.o(.bss)
		cmos.o(.bss)
		console.o(.bss)
		disk.o(.bss)
		elf.o(.bss)
		exception.o(.bss)
		font.o(.bss)
		fontdata.o(.bss)
		gdt.o(.bss)
		graphic.o(.bss)
		idt.o(.bss)
		interrupt_gates.o(.bss)
		interrupt_handlers.o(.bss)
		io.o(.bss)
		keyboard.o(.bss)
		libgcc.o(.bss)
		math.o(.bss)
		memory.o(.bss)
		mouse.o(.bss)
		mouse_cursor.o(.bss)
		parallel.o(.bss)
		peripheral.o(.bss)
		pic.o(.bss)
		pit.o(.bss)
		queue.o(.bss)
		rtc.o(.bss)
		serial.o(.bss)
		sheet.o(.bss)
		shell.o(.bss)
		stack.o(.bss)
		stdio.o(.bss)
		string.o(.bss)
		task.o(.bss)
		text_box.o(.bss)
		timer.o(.bss)
		window.o(.bss)
	}
	COMMON :
	{
		main.o(COMMON)
		chain_string.o(COMMON)
		cmos.o(COMMON)
		console.o(COMMON)
		disk.o(COMMON)
		elf.o(COMMON)
		exception.o(COMMON)
		font.o(COMMON)
		fontdata.o(COMMON)
		gdt.o(COMMON)
		graphic.o(COMMON)
		idt.o(COMMON)
		interrupt_gates.o(COMMON)
		interrupt_handlers.o(COMMON)
		io.o(COMMON)
		keyboard.o(COMMON)
		libgcc.o(COMMON)
		math.o(COMMON)
		memory.o(COMMON)
		mouse.o(COMMON)
		mouse_cursor.o(COMMON)
		parallel.o(COMMON)
		peripheral.o(COMMON)
		pic.o(COMMON)
		pit.o(COMMON)
		queue.o(COMMON)
		rtc.o(COMMON)
		serial.o(COMMON)
		sheet.o(COMMON)
		shell.o(COMMON)
		stack.o(COMMON)
		stdio.o(COMMON)
		string.o(COMMON)
		task.o(COMMON)
		text_box.o(COMMON)
		timer.o(COMMON)
		window.o(COMMON)
	}
	.common_deletion_prevention :
	{
		BYTE(0xff);
	}
	/DISCARD/ :
	{
		*(.eh_frame)
		*(.note.gnu.property)
	}
}

